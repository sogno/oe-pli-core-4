## meta-openpli/conf/machine/sogno8800hd.conf
```bitbake
#@TYPE: Machine
#@NAME: Sogno 8800 HD
#@DESCRIPTION: Machine configuration for the Sogno

require conf/machine/include/sogno.inc

MACHINE_BRAND = "Sogno"

MACHINE_NAME = "8800HD"

MACHINE_ESSENTIAL_EXTRA_RDEPENDS = "\
	sogno-dvb-modules-sogno8800hd \
	"
	
PREFERRED_VERSION_linux-sogno = "3.9.7"
PREFERRED_VERSION_linux-libc-headers = "3.8"

OPENPLI_FEATURES = "ci"

MACHINE_FEATURES += "textlcd fanctrl ci dvb-c"

CHIPSET = "bcm7413"

TARGET_FPU = "hard"

MACHINE_KERNEL_PR = "r1"

IMAGEDIR ?= "sogno/8800hd"

UBI_VOLNAME = "rootfs"
MKUBIFS_ARGS = "-m 2048 -e 126976 -c 4096 -F"
UBINIZE_ARGS = "-m 2048 -p 128KiB"

IMAGE_CMD_ubi_append = " \
	mkdir -p ${DEPLOY_DIR_IMAGE}/${IMAGEDIR}; \
	cp ${DEPLOY_DIR_IMAGE}/splash.bin ${DEPLOY_DIR_IMAGE}/${IMAGEDIR}/splash.bin; \
	mv ${DEPLOY_DIR_IMAGE}/${IMAGE_NAME}.rootfs.ubi ${DEPLOY_DIR_IMAGE}/${IMAGEDIR}/rootfs.bin; \
	gzip -f -9c ${DEPLOY_DIR_IMAGE}/vmlinux-${MACHINE}.bin > ${DEPLOY_DIR_IMAGE}/${IMAGEDIR}/kernel.bin; \
	echo ${DISTRO_NAME}-${IMAGE_VERSION}-${MACHINE}-${DATE}_usb > ${DEPLOY_DIR_IMAGE}/${IMAGEDIR}/imageversion; \
	echo "rename this file to 'force' to force an update without confirmation" > ${DEPLOY_DIR_IMAGE}/${IMAGEDIR}/noforce; \
	cd ${DEPLOY_DIR_IMAGE}; \
	zip ${IMAGE_NAME}-${DATE}_usb.zip ${IMAGEDIR}/*; \
	rm -f ${DEPLOY_DIR_IMAGE}/*.ubifs; \
	rm -rf sogno; \
	"
```
